/*********************************************************************************
* 【编写时间】： 2014年3月5日
* 【作    者】： 清翔电子:03
* 【版    本】： 1.0
* 【网    站】： http://www.qxmcu.com/ 
* 【淘宝店铺】： http://qxmcu.taobao.com/ 
* 【实验平台】： QX-MCS51 单片机开发板
* 【外部晶振】： 11.0592mhz	
* 【主控芯片】： STC89C52
* 【编译环境】： Keil μVisio3	
* 【程序功能】： 			   			            			    
* 【使用说明】： 结合独立按键实现
*  说明：免费开源，不提供源代码分析.
**********************************************************************************/
/******************************************************************
程序功能：	通过实例说明switch语句的功能。特别注意switch语句的格式，在此很容易犯错。	
****************************************************************************/
#include <reg51.h>

sbit s2=P3^0;
sbit s3=P3^1;
sbit s4=P3^2;
sbit s5=P3^3;

void main()
{
	char anjian;
	while(1)   //无条件永远执行大循环
	{
		if(!s2)			  //这些按键按下，就会使anjian变量赋以相应的值。
			anjian=1;
		if(!s3)
			anjian=2;
		if(!s4)
			anjian=3;
		if(!s5)
			anjian=4;

		switch(anjian)	//当按键的值为几，程序就跳转到case几执行指令，让然后跳出
		{//这个大括弧一定不可少
			case 1: P1=0X0F; break;//这个break也不可少
			case 2: P1=0Xf0; break;
			case 3: P1=0X55; break;
			case 4: P1=0Xaa; break;
			default:P1=0X00; break;//这个为当anjian取值为其他值时的结果（注意关键字为default）。
		}						   //又由于在刚定义变量anjian时，变量的值为初始值0，而0不属于上面的数值，
								   //故此时default项即被选中，故刚开机时，为8个LED均亮。
	}
}