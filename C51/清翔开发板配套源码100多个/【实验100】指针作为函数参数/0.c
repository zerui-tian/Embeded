/*********************************************************************************
* 【编写时间】： 2014年3月5日
* 【作    者】： 清翔电子:03
* 【版    本】： 1.0
* 【网    站】： http://www.qxmcu.com/ 
* 【淘宝店铺】： http://qxmcu.taobao.com/ 
* 【实验平台】： QX-MCS51 单片机开发板
* 【外部晶振】： 11.0592mhz	
* 【主控芯片】： STC89C52
* 【编译环境】： Keil μVisio3	
* 【程序功能】： 			   			            			    
* 【使用说明】： 
*  说明：免费开源，不提供源代码分析.
**********************************************************************************/
/******************************************************************
程序功能：	演示指针作为函数的参数。
****************************************************************************/
#include <reg52.h>

void delay(void)  //此延时函数无参数，无返回值。在其后面作了一个有参数的延时函数作为对比
{
  unsigned char m,n;
  for(m=0;m<200;m++)
  	for(n=0;n<200;n++);
}
void led(unsigned char *p) //形参为无符号字符型指针
{
  unsigned char i;
  while(1)
   {
	  i=0;   //将i置为0，指向数组第一个元素
	  while(i!=16) 
	   {
        P1=*(p+i);// 取的指针所指变量（数组元素）的值，送P1口
	     delay();   //调用延时函数
		  i++;    //指向下一个数组元素
	   }
	}
}


void main(void)
{  
  unsigned  char code table[16]={0xFE,0xFD,0xFB,0xF7,0xEF,0xDF,0xBF,0x7F, 
                              0x7F,0xBF,0xDF,0xEF,0xF7,0xFB,0xFD,0xFE};
										//流水灯控制码 
  unsigned char *p;
  p=table;
  led(p);
  
}